#include <behaviors.dtsi>
#include <behaviors/num_word.dtsi> // Requires zmk-auto-layer module.
#include <zmk-helpers/helper.h>
#include "zmk-helpers/key-labels/42.h"
#include <dt-bindings/zmk/keys.h>
#include <dt-bindings/zmk/bt.h>

#define XXX &none
#define ___ &trans
#define QUICK_TAP_MS 175

#define DEF 0
#define NUM 1
#define FN 2
#define SYS 3
#define NAV 4
#define MOUSE 5
#define QWERTY 6
#define GAMING 7
#define GAMNUM 8

// Define mod-morph with a *single* mod trigger for less repetition.
#define SIMPLE_MORPH(NAME, MOD, BINDING1, BINDING2)                            \
  ZMK_MOD_MORPH(NAME, mods = <(MOD_L##MOD | MOD_R##MOD)>;                      \
                bindings = <BINDING1>, <BINDING2>;)

// Tap: left/right parenthesis | Shft + tap: less-than/greater-than.
SIMPLE_MORPH(lpar_lt, SFT, &kp LPAR, &kp LT)
SIMPLE_MORPH(rpar_gt, SFT, &kp RPAR, &kp GT)

// Tap: comma | Shift + tap: semicolon | Ctrl + shift + tap: <.
SIMPLE_MORPH(comma_morph, SFT, &kp COMMA, &comma_inner_morph)
SIMPLE_MORPH(comma_inner_morph, CTL, &kp SEMICOLON, &kp LESS_THAN)

// Tap: dot | Shift + tap: colon | Ctrl + shift + tap: >.
SIMPLE_MORPH(dot_morph, SFT, &kp DOT, &dot_inner_morph)
SIMPLE_MORPH(dot_inner_morph, CTL, &kp COLON, &kp GREATER_THAN)

// Tap: qmark | Shift + tap: excl.
SIMPLE_MORPH(qexcl, SFT, &kp QMARK, &kp EXCL)

// Tap: space | Shift + tap: dot -> space -> sticky shift | Hold: nav layer.
ZMK_HOLD_TAP(lt_spc, bindings = <&mo>, <&spc_morph>; flavor = "balanced";
             tapping-term-ms = <200>; quick-tap-ms = <QUICK_TAP_MS>;)
SIMPLE_MORPH(spc_morph, SFT, &kp SPACE, &dot_spc)
ZMK_MACRO(dot_spc, bindings = <&kp DOT &kp SPACE &sk LSHFT>; wait-ms = <0>;
          tap-ms = <5>;)

#define KEYS_L LT0 LT1 LT2 LT3 LT4 LT5 LM0 LM1 LM2 LM3 LM4 LM5 LB0 LB1 LB2 LB3 LB4 LB5
#define KEYS_R RT0 RT1 RT2 RT3 RT4 RT5 RM0 RM1 RM2 RM3 RM4 RM5 RB0 RB1 RB2 RB3 RB4 RB5
#define THUMBS LH2 LH1 LH0 RH0 RH1 RH2

#define MAKE_HRM(NAME, HOLD, TAP, TRIGGER_POS)                                 \
  ZMK_HOLD_TAP(NAME, bindings = <HOLD>, <TAP>; flavor = "balanced";            \
               tapping-term-ms = <280>; quick-tap-ms = <QUICK_TAP_MS>;         \
               require-prior-idle-ms = <150>; hold-trigger-on-release;         \
               hold-trigger-key-positions = <TRIGGER_POS>;)

MAKE_HRM(hml, &kp, &kp, KEYS_R THUMBS) // Left-hand HRMs.
MAKE_HRM(hmr, &kp, &kp, KEYS_L THUMBS) // Right-hand HRMs.

// Hack: Make HRM combos tap-only (cf, ZMK issue #544).
#define ZMK_COMBO_8(NAME, TAP, POS, LAYERS, COMBO_MS, IDLE_MS, HOLD, SIDE)     \
  MAKE_HRM(hm_combo_##NAME, &kp, TAP, SIDE THUMBS)                             \
  ZMK_COMBO_6(NAME, &hm_combo_##NAME HOLD 0, POS, LAYERS, COMBO_MS, IDLE_MS)

// Tap: num-word | double-tap: sticky num-layer | Hold: num-layer.
#define SMART_NUM &smart_num NUM 0
ZMK_HOLD_TAP(smart_num, bindings = <&mo>, <&num_dance>; flavor = "balanced";
             tapping-term-ms = <200>; quick-tap-ms = <QUICK_TAP_MS>;)
ZMK_TAP_DANCE(num_dance, bindings = <&num_word NUM>, <&sl NUM>;
              tapping-term-ms = <200>;)

// Mask CTRL on left/right hold to avoid accidental jumps to start/end of doc.
#define MASK_MODS(NAME, MODS, BINDING)                                         \
  ZMK_MOD_MORPH(NAME, bindings = <BINDING>, <BINDING>; mods = <MODS>;)

MASK_MODS(masked_home, (MOD_LCTL), &kp HOME)
MASK_MODS(masked_end,  (MOD_LCTL), &kp END)

/* Nav cluster */

// Trigger tap-action on all interrupts.
#define MT_CORE                                                                \
  flavor = "tap-preferred";                                                    \
  tapping-term-ms = <220>;                                                     \
  quick-tap-ms = <220>;                                                        \
  hold-trigger-key-positions = <0>;

&mt { MT_CORE };

ZMK_HOLD_TAP(mt_home, bindings = <&masked_home>, <&kp>; MT_CORE)
ZMK_HOLD_TAP(mt_end, bindings = <&masked_end>, <&kp>; MT_CORE)

#define NAV_LEFT  &mt_home 0   LEFT  // Tap: left  | Long-tap: start of line.
#define NAV_RIGHT &mt_end 0    RIGHT // Tap: right | Long-tap: end   of line.
#define NAV_UP    &mt LC(HOME) UP    // Tap: up    | Long-tap: start of doc.
#define NAV_DOWN  &mt LC(END)  DOWN  // Tap: down  | Long-tap: end   of doc.
#define NAV_BSPC  &mt LC(BSPC) BSPC  // Tap: bspc  | Long-tap: delete word bwd.
#define NAV_DEL   &mt LC(DEL)  DEL   // Tap: del   | Long-tap: delete word fwd.

#include "combos.dtsi"
#include "mouse.dtsi"

// Smart-mouse, requires tri-state module.
ZMK_TRI_STATE(
    smart_mouse, bindings = <&tog MOUSE>, <&none>, <&tog MOUSE>;
    ignored-key-positions =
        <LT1 LT2 LH0 LH1 RT1 RT2 RT3 RM0 RM1 RM2 RM3 RM4 RB1 RB2 RB3 RH0 RH1>;
    ignored-layers = <MOUSE NAV FN>;)

ZMK_CONDITIONAL_LAYER(sys, FN NUM, SYS) // FN + NUM --> SYS.

// Keymap
#ifndef ZMK_BASE_LAYER
  #define ZMK_BASE_LAYER(name, LT, RT, LM, RM, LB, RB, LH, RH)                 \
      ZMK_LAYER(name, LT RT LM RM LB RB LH RH)
#endif

ZMK_BASE_LAYER(Base,
   XXX &kp B      &kp L       &kp D        &kp W        &kp Z,       &kp SQT &kp F         &kp O          &kp U         &kp J      XXX,
   XXX &hml LGUI N &hml LALT R &hml LSHFT T &hml LCTRL S &kp G,       &kp Y   &hmr RCTRL H  &hmr RSHFT A   &hmr RALT E   &hmr RGUI I XXX,
   XXX &kp Q      &kp X       &kp M        &kp C        &kp V,       &kp K   &kp P         &comma_morph   &dot_morph    &qexcl     &to GAMING,
                              &kp ESC     &lt_spc NAV 0 &lt FN SPACE,   &kp RET SMART_NUM     &kp TAB
)
 
ZMK_BASE_LAYER(Num,
   ___ ___         &kp N7       &kp N8        &kp N9        ___,       ___     ___         ___            ___           ___        ___,
   ___ &hml LGUI N0 &hml LALT N4 &hml LSHFT N5 &hml LCTRL N6 ___,       ___     ___         ___            ___           ___        ___,
   ___ ___         &kp N1       &kp N2        &kp N3        ___,       ___     ___         ___            ___           ___        ___,
                                ___           ___           ___,       ___     ___         ___
)

ZMK_BASE_LAYER(Fn,
   ___ &kp F12         &kp F7       &kp F8        &kp F9        ___,       ___     ___         ___            ___           ___        ___,
   ___ &hml LGUI F11   &hml LALT F4 &hml LSHFT F5 &hml LCTRL F6 ___,       ___     ___         ___            ___           ___        ___,
   ___ &kp F10         &kp F1       &kp F2        &kp F3        ___,       ___     ___         ___            ___           ___        ___,
                                    ___           ___           ___,       ___     ___         ___
)

ZMK_BASE_LAYER(Sys,
   &bt BT_CLR &bt BT_SEL 0 &bt BT_SEL 1 &bt BT_SEL 2 &bt BT_SEL 3 &bt BT_SEL 4, ___ ___      ___            ___           ___        ___,
   ___ ___         ___          ___           ___             ___,       ___     ___         ___            ___           ___        ___,
   ___ ___         ___          ___           ___             ___,       ___     ___         ___            ___           ___        ___,
                                ___           ___             ___,       ___     ___         ___
)

ZMK_BASE_LAYER(Nav,
   ___ ___         ___          ___           ___             ___,       ___     NAV_BSPC    ___            NAV_DEL       ___        ___,
   ___ ___         ___          ___           ___             ___,       NAV_LEFT    NAV_DOWN       NAV_UP        NAV_RIGHT  ___     ___,
   ___ ___         ___          ___           ___             ___,       ___     ___         ___            ___           ___        ___,
                                ___           ___             ___,       ___     ___         ___
)
ZMK_BASE_LAYER(Mouse,
//╭─────────────┬─────────────┬─────────────┬─────────────┬─────────────╮ ╭─────────────┬─────────────┬─────────────┬─────────────┬─────────────╮
    ___           ___           ___           ___           ___         ___,   ___           &kp PG_UP     U_MS_U         &kp PG_DN    ___         ___,
//├─────────────┼─────────────┼─────────────┼─────────────┼─────────────┤ ├─────────────┼─────────────┼─────────────┼─────────────┼─────────────┤
    ___           ___           ___           ___           ___         ___,   U_WH_L        U_MS_L        U_MS_D         U_MS_R       U_WH_R      ___,
//├─────────────┼─────────────┼─────────────┼─────────────┼─────────────┤ ├─────────────┼─────────────┼─────────────┼─────────────┼─────────────┤
    ___           ___           ___           ___           ___         ___,   ___           &mkp LCLK     &mkp MCLK      &mkp RCLK    ___         ___,
//╰─────────────┼─────────────┴─────────────┼─────────────┼─────────────┤ ├─────────────┼─────────────┼─────────────┴───────────────────────────╯
                                              ___           ___         ___,   U_WH_U        U_WH_D  ___
//                                          ╰─────────────┴─────────────╯ ╰─────────────┴─────────────╯
)
ZMK_BASE_LAYER(Qwerty,
   XXX &kp Q      &kp W       &kp E        &kp R        &kp T,       &kp Y &kp U         &kp I          &kp O         &kp P      XXX,
   XXX &hml LGUI A &hml LALT S &hml LSHFT D &hml LCTRL F &kp G,       &kp H   &hmr RCTRL J  &hmr RSHFT K   &hmr RALT L   &hmr RGUI I XXX,
   XXX &kp Z      &kp X       &kp C        &kp V        &kp B,       &kp N   &kp M         &comma_morph   &dot_morph    &qexcl     &to DEF,
                              &kp LGUI     &lt_spc NAV 0 &lt FN SPACE,   &kp RET SMART_NUM     &kp RALT
)
ZMK_BASE_LAYER(Gaming,
   &kp ESC   &kp Q      &kp F       &kp E        &kp R        &kp T,       &kp Y   &kp U         &kp I          &kp O         &kp P      XXX,
   &kp TAB   &kp S      &kp A       &kp W        &kp D        &kp G,       &kp H   &hmr RCTRL J  &hmr RSHFT K   &hmr RALT L   &hmr RGUI I XXX,
   &kp LSHFT &kp Z      &kp X       &kp C        &kp V        &kp B,       &kp N   &kp M         &comma_morph   &dot_morph    &qexcl     &to DEF,
                              &mo GAMNUM  &kp E &kp SPACE,   &kp RET SMART_NUM     &kp RALT
)
ZMK_BASE_LAYER(GameNum,
   ___ ___      &kp N4      &kp N5      &kp N6        ___,       ___   ___   ___   ___   ___  ___,
   ___ &kp N0   &kp N1      &kp N2      &kp N3        ___,       ___   ___   ___   ___   ___  ___,
   ___ ___      &kp N7      &kp N8      &kp N9        ___,       ___   ___   ___   ___   ___  ___,
                              ___     ___ ___,   ___ ___     ___
)
